OUTPUT_FORMAT("elf64-x86-64")
ENTRY(_start)

SECTIONS
{
  . = 1024*1024 + SIZEOF_HEADERS;

  .text :
  {
    . = ALIGN(0x1000);
    _section_text_start = .;
    *(.text)
    *(.text.*)
    . = ALIGN(0x1000);
    _section_text_end = .;
  }

  .rodata :
  {
    . = ALIGN(0x1000);
    _section_rodata_start = .;
    *(.rodata)
    *(.rodata.*)

    . = ALIGN(0x20);
    idt_entries = .;
    SHORT(intr_handler_0)   SHORT(8) BYTE(0) BYTE(6|8|0|128) SHORT(intr_handler_0>>16)   LONG(intr_handler_0>>32)   LONG(0)
    SHORT(intr_handler_1)   SHORT(8) BYTE(0) BYTE(6|8|0|128) SHORT(intr_handler_1>>16)   LONG(intr_handler_1>>32)   LONG(0)
    SHORT(intr_handler_2)   SHORT(8) BYTE(0) BYTE(6|8|0|128) SHORT(intr_handler_2>>16)   LONG(intr_handler_2>>32)   LONG(0)
    SHORT(intr_handler_3)   SHORT(8) BYTE(0) BYTE(6|8|0|128) SHORT(intr_handler_3>>16)   LONG(intr_handler_3>>32)   LONG(0)
    SHORT(intr_handler_4)   SHORT(8) BYTE(0) BYTE(6|8|0|128) SHORT(intr_handler_4>>16)   LONG(intr_handler_4>>32)   LONG(0)
    SHORT(intr_handler_5)   SHORT(8) BYTE(0) BYTE(6|8|0|128) SHORT(intr_handler_5>>16)   LONG(intr_handler_5>>32)   LONG(0)
    SHORT(intr_handler_6)   SHORT(8) BYTE(0) BYTE(6|8|0|128) SHORT(intr_handler_6>>16)   LONG(intr_handler_6>>32)   LONG(0)
    SHORT(intr_handler_7)   SHORT(8) BYTE(0) BYTE(6|8|0|128) SHORT(intr_handler_7>>16)   LONG(intr_handler_7>>32)   LONG(0)
    SHORT(intr_handler_8)   SHORT(8) BYTE(0) BYTE(6|8|0|128) SHORT(intr_handler_8>>16)   LONG(intr_handler_8>>32)   LONG(0)
    SHORT(intr_handler_9)   SHORT(8) BYTE(0) BYTE(6|8|0|128) SHORT(intr_handler_9>>16)   LONG(intr_handler_9>>32)   LONG(0)
    SHORT(intr_handler_10)  SHORT(8) BYTE(0) BYTE(6|8|0|128) SHORT(intr_handler_10>>16)  LONG(intr_handler_10>>32)  LONG(0)
    SHORT(intr_handler_11)  SHORT(8) BYTE(0) BYTE(6|8|0|128) SHORT(intr_handler_11>>16)  LONG(intr_handler_11>>32)  LONG(0)
    SHORT(intr_handler_12)  SHORT(8) BYTE(0) BYTE(6|8|0|128) SHORT(intr_handler_12>>16)  LONG(intr_handler_12>>32)  LONG(0)
    SHORT(intr_handler_13)  SHORT(8) BYTE(0) BYTE(6|8|0|128) SHORT(intr_handler_13>>16)  LONG(intr_handler_13>>32)  LONG(0)
    SHORT(intr_handler_14)  SHORT(8) BYTE(0) BYTE(6|8|0|128) SHORT(intr_handler_14>>16)  LONG(intr_handler_14>>32)  LONG(0)
    SHORT(intr_handler_15)  SHORT(8) BYTE(0) BYTE(6|8|0|128) SHORT(intr_handler_15>>16)  LONG(intr_handler_15>>32)  LONG(0)
    SHORT(intr_handler_16)  SHORT(8) BYTE(0) BYTE(6|8|0|128) SHORT(intr_handler_16>>16)  LONG(intr_handler_16>>32)  LONG(0)
    SHORT(intr_handler_17)  SHORT(8) BYTE(0) BYTE(6|8|0|128) SHORT(intr_handler_17>>16)  LONG(intr_handler_17>>32)  LONG(0)
    SHORT(intr_handler_18)  SHORT(8) BYTE(0) BYTE(6|8|0|128) SHORT(intr_handler_18>>16)  LONG(intr_handler_18>>32)  LONG(0)
    SHORT(intr_handler_19)  SHORT(8) BYTE(0) BYTE(6|8|0|128) SHORT(intr_handler_19>>16)  LONG(intr_handler_19>>32)  LONG(0)
    SHORT(intr_handler_20)  SHORT(8) BYTE(0) BYTE(6|8|0|128) SHORT(intr_handler_20>>16)  LONG(intr_handler_20>>32)  LONG(0)
    SHORT(intr_handler_21)  SHORT(8) BYTE(0) BYTE(6|8|0|128) SHORT(intr_handler_21>>16)  LONG(intr_handler_21>>32)  LONG(0)
    SHORT(intr_handler_22)  SHORT(8) BYTE(0) BYTE(6|8|0|128) SHORT(intr_handler_22>>16)  LONG(intr_handler_22>>32)  LONG(0)
    SHORT(intr_handler_23)  SHORT(8) BYTE(0) BYTE(6|8|0|128) SHORT(intr_handler_23>>16)  LONG(intr_handler_23>>32)  LONG(0)
    SHORT(intr_handler_24)  SHORT(8) BYTE(0) BYTE(6|8|0|128) SHORT(intr_handler_24>>16)  LONG(intr_handler_24>>32)  LONG(0)
    SHORT(intr_handler_25)  SHORT(8) BYTE(0) BYTE(6|8|0|128) SHORT(intr_handler_25>>16)  LONG(intr_handler_25>>32)  LONG(0)
    SHORT(intr_handler_26)  SHORT(8) BYTE(0) BYTE(6|8|0|128) SHORT(intr_handler_26>>16)  LONG(intr_handler_26>>32)  LONG(0)
    SHORT(intr_handler_27)  SHORT(8) BYTE(0) BYTE(6|8|0|128) SHORT(intr_handler_27>>16)  LONG(intr_handler_27>>32)  LONG(0)
    SHORT(intr_handler_28)  SHORT(8) BYTE(0) BYTE(6|8|0|128) SHORT(intr_handler_28>>16)  LONG(intr_handler_28>>32)  LONG(0)
    SHORT(intr_handler_29)  SHORT(8) BYTE(0) BYTE(6|8|0|128) SHORT(intr_handler_29>>16)  LONG(intr_handler_29>>32)  LONG(0)
    SHORT(intr_handler_30)  SHORT(8) BYTE(0) BYTE(6|8|0|128) SHORT(intr_handler_30>>16)  LONG(intr_handler_30>>32)  LONG(0)
    SHORT(intr_handler_31)  SHORT(8) BYTE(0) BYTE(6|8|0|128) SHORT(intr_handler_31>>16)  LONG(intr_handler_31>>32)  LONG(0)
    SHORT(intr_handler_32)  SHORT(8) BYTE(0) BYTE(6|8|0|128) SHORT(intr_handler_32>>16)  LONG(intr_handler_32>>32)  LONG(0)
    SHORT(intr_handler_33)  SHORT(8) BYTE(0) BYTE(6|8|0|128) SHORT(intr_handler_33>>16)  LONG(intr_handler_33>>32)  LONG(0)
    SHORT(intr_handler_34)  SHORT(8) BYTE(0) BYTE(6|8|0|128) SHORT(intr_handler_34>>16)  LONG(intr_handler_34>>32)  LONG(0)
    SHORT(intr_handler_35)  SHORT(8) BYTE(0) BYTE(6|8|0|128) SHORT(intr_handler_35>>16)  LONG(intr_handler_35>>32)  LONG(0)
    SHORT(intr_handler_36)  SHORT(8) BYTE(0) BYTE(6|8|0|128) SHORT(intr_handler_36>>16)  LONG(intr_handler_36>>32)  LONG(0)
    SHORT(intr_handler_37)  SHORT(8) BYTE(0) BYTE(6|8|0|128) SHORT(intr_handler_37>>16)  LONG(intr_handler_37>>32)  LONG(0)
    SHORT(intr_handler_38)  SHORT(8) BYTE(0) BYTE(6|8|0|128) SHORT(intr_handler_38>>16)  LONG(intr_handler_38>>32)  LONG(0)
    SHORT(intr_handler_39)  SHORT(8) BYTE(0) BYTE(6|8|0|128) SHORT(intr_handler_39>>16)  LONG(intr_handler_39>>32)  LONG(0)
    SHORT(intr_handler_40)  SHORT(8) BYTE(0) BYTE(6|8|0|128) SHORT(intr_handler_40>>16)  LONG(intr_handler_40>>32)  LONG(0)
    SHORT(intr_handler_41)  SHORT(8) BYTE(0) BYTE(6|8|0|128) SHORT(intr_handler_41>>16)  LONG(intr_handler_41>>32)  LONG(0)
    SHORT(intr_handler_42)  SHORT(8) BYTE(0) BYTE(6|8|0|128) SHORT(intr_handler_42>>16)  LONG(intr_handler_42>>32)  LONG(0)
    SHORT(intr_handler_43)  SHORT(8) BYTE(0) BYTE(6|8|0|128) SHORT(intr_handler_43>>16)  LONG(intr_handler_43>>32)  LONG(0)
    SHORT(intr_handler_44)  SHORT(8) BYTE(0) BYTE(6|8|0|128) SHORT(intr_handler_44>>16)  LONG(intr_handler_44>>32)  LONG(0)
    SHORT(intr_handler_45)  SHORT(8) BYTE(0) BYTE(6|8|0|128) SHORT(intr_handler_45>>16)  LONG(intr_handler_45>>32)  LONG(0)
    SHORT(intr_handler_46)  SHORT(8) BYTE(0) BYTE(6|8|0|128) SHORT(intr_handler_46>>16)  LONG(intr_handler_46>>32)  LONG(0)
    SHORT(intr_handler_47)  SHORT(8) BYTE(0) BYTE(6|8|0|128) SHORT(intr_handler_47>>16)  LONG(intr_handler_47>>32)  LONG(0)
    SHORT(intr_handler_48)  SHORT(8) BYTE(0) BYTE(6|8|0|128) SHORT(intr_handler_48>>16)  LONG(intr_handler_48>>32)  LONG(0)
    SHORT(intr_handler_49)  SHORT(8) BYTE(0) BYTE(6|8|0|128) SHORT(intr_handler_49>>16)  LONG(intr_handler_49>>32)  LONG(0)
    SHORT(intr_handler_50)  SHORT(8) BYTE(0) BYTE(6|8|0|128) SHORT(intr_handler_50>>16)  LONG(intr_handler_50>>32)  LONG(0)
    SHORT(intr_handler_51)  SHORT(8) BYTE(0) BYTE(6|8|0|128) SHORT(intr_handler_51>>16)  LONG(intr_handler_51>>32)  LONG(0)
    SHORT(intr_handler_52)  SHORT(8) BYTE(0) BYTE(6|8|0|128) SHORT(intr_handler_52>>16)  LONG(intr_handler_52>>32)  LONG(0)
    SHORT(intr_handler_53)  SHORT(8) BYTE(0) BYTE(6|8|0|128) SHORT(intr_handler_53>>16)  LONG(intr_handler_53>>32)  LONG(0)
    SHORT(intr_handler_54)  SHORT(8) BYTE(0) BYTE(6|8|0|128) SHORT(intr_handler_54>>16)  LONG(intr_handler_54>>32)  LONG(0)
    SHORT(intr_handler_55)  SHORT(8) BYTE(0) BYTE(6|8|0|128) SHORT(intr_handler_55>>16)  LONG(intr_handler_55>>32)  LONG(0)
    SHORT(intr_handler_56)  SHORT(8) BYTE(0) BYTE(6|8|0|128) SHORT(intr_handler_56>>16)  LONG(intr_handler_56>>32)  LONG(0)
    SHORT(intr_handler_57)  SHORT(8) BYTE(0) BYTE(6|8|0|128) SHORT(intr_handler_57>>16)  LONG(intr_handler_57>>32)  LONG(0)
    SHORT(intr_handler_58)  SHORT(8) BYTE(0) BYTE(6|8|0|128) SHORT(intr_handler_58>>16)  LONG(intr_handler_58>>32)  LONG(0)
    SHORT(intr_handler_59)  SHORT(8) BYTE(0) BYTE(6|8|0|128) SHORT(intr_handler_59>>16)  LONG(intr_handler_59>>32)  LONG(0)
    SHORT(intr_handler_60)  SHORT(8) BYTE(0) BYTE(6|8|0|128) SHORT(intr_handler_60>>16)  LONG(intr_handler_60>>32)  LONG(0)
    SHORT(intr_handler_61)  SHORT(8) BYTE(0) BYTE(6|8|0|128) SHORT(intr_handler_61>>16)  LONG(intr_handler_61>>32)  LONG(0)
    SHORT(intr_handler_62)  SHORT(8) BYTE(0) BYTE(6|8|0|128) SHORT(intr_handler_62>>16)  LONG(intr_handler_62>>32)  LONG(0)
    SHORT(intr_handler_63)  SHORT(8) BYTE(0) BYTE(6|8|0|128) SHORT(intr_handler_63>>16)  LONG(intr_handler_63>>32)  LONG(0)
    SHORT(intr_handler_64)  SHORT(8) BYTE(0) BYTE(6|8|0|128) SHORT(intr_handler_64>>16)  LONG(intr_handler_64>>32)  LONG(0)
    SHORT(intr_handler_65)  SHORT(8) BYTE(0) BYTE(6|8|0|128) SHORT(intr_handler_65>>16)  LONG(intr_handler_65>>32)  LONG(0)
    SHORT(intr_handler_66)  SHORT(8) BYTE(0) BYTE(6|8|0|128) SHORT(intr_handler_66>>16)  LONG(intr_handler_66>>32)  LONG(0)
    SHORT(intr_handler_67)  SHORT(8) BYTE(0) BYTE(6|8|0|128) SHORT(intr_handler_67>>16)  LONG(intr_handler_67>>32)  LONG(0)
    SHORT(intr_handler_68)  SHORT(8) BYTE(0) BYTE(6|8|0|128) SHORT(intr_handler_68>>16)  LONG(intr_handler_68>>32)  LONG(0)
    SHORT(intr_handler_69)  SHORT(8) BYTE(0) BYTE(6|8|0|128) SHORT(intr_handler_69>>16)  LONG(intr_handler_69>>32)  LONG(0)
    SHORT(intr_handler_70)  SHORT(8) BYTE(0) BYTE(6|8|0|128) SHORT(intr_handler_70>>16)  LONG(intr_handler_70>>32)  LONG(0)
    SHORT(intr_handler_71)  SHORT(8) BYTE(0) BYTE(6|8|0|128) SHORT(intr_handler_71>>16)  LONG(intr_handler_71>>32)  LONG(0)
    SHORT(intr_handler_72)  SHORT(8) BYTE(0) BYTE(6|8|0|128) SHORT(intr_handler_72>>16)  LONG(intr_handler_72>>32)  LONG(0)
    SHORT(intr_handler_73)  SHORT(8) BYTE(0) BYTE(6|8|0|128) SHORT(intr_handler_73>>16)  LONG(intr_handler_73>>32)  LONG(0)
    SHORT(intr_handler_74)  SHORT(8) BYTE(0) BYTE(6|8|0|128) SHORT(intr_handler_74>>16)  LONG(intr_handler_74>>32)  LONG(0)
    SHORT(intr_handler_75)  SHORT(8) BYTE(0) BYTE(6|8|0|128) SHORT(intr_handler_75>>16)  LONG(intr_handler_75>>32)  LONG(0)
    SHORT(intr_handler_76)  SHORT(8) BYTE(0) BYTE(6|8|0|128) SHORT(intr_handler_76>>16)  LONG(intr_handler_76>>32)  LONG(0)
    SHORT(intr_handler_77)  SHORT(8) BYTE(0) BYTE(6|8|0|128) SHORT(intr_handler_77>>16)  LONG(intr_handler_77>>32)  LONG(0)
    SHORT(intr_handler_78)  SHORT(8) BYTE(0) BYTE(6|8|0|128) SHORT(intr_handler_78>>16)  LONG(intr_handler_78>>32)  LONG(0)
    SHORT(intr_handler_79)  SHORT(8) BYTE(0) BYTE(6|8|0|128) SHORT(intr_handler_79>>16)  LONG(intr_handler_79>>32)  LONG(0)
    SHORT(intr_handler_80)  SHORT(8) BYTE(0) BYTE(6|8|0|128) SHORT(intr_handler_80>>16)  LONG(intr_handler_80>>32)  LONG(0)
    SHORT(intr_handler_81)  SHORT(8) BYTE(0) BYTE(6|8|0|128) SHORT(intr_handler_81>>16)  LONG(intr_handler_81>>32)  LONG(0)
    SHORT(intr_handler_82)  SHORT(8) BYTE(0) BYTE(6|8|0|128) SHORT(intr_handler_82>>16)  LONG(intr_handler_82>>32)  LONG(0)
    SHORT(intr_handler_83)  SHORT(8) BYTE(0) BYTE(6|8|0|128) SHORT(intr_handler_83>>16)  LONG(intr_handler_83>>32)  LONG(0)
    SHORT(intr_handler_84)  SHORT(8) BYTE(0) BYTE(6|8|0|128) SHORT(intr_handler_84>>16)  LONG(intr_handler_84>>32)  LONG(0)
    SHORT(intr_handler_85)  SHORT(8) BYTE(0) BYTE(6|8|0|128) SHORT(intr_handler_85>>16)  LONG(intr_handler_85>>32)  LONG(0)
    SHORT(intr_handler_86)  SHORT(8) BYTE(0) BYTE(6|8|0|128) SHORT(intr_handler_86>>16)  LONG(intr_handler_86>>32)  LONG(0)
    SHORT(intr_handler_87)  SHORT(8) BYTE(0) BYTE(6|8|0|128) SHORT(intr_handler_87>>16)  LONG(intr_handler_87>>32)  LONG(0)
    SHORT(intr_handler_88)  SHORT(8) BYTE(0) BYTE(6|8|0|128) SHORT(intr_handler_88>>16)  LONG(intr_handler_88>>32)  LONG(0)
    SHORT(intr_handler_89)  SHORT(8) BYTE(0) BYTE(6|8|0|128) SHORT(intr_handler_89>>16)  LONG(intr_handler_89>>32)  LONG(0)
    SHORT(intr_handler_90)  SHORT(8) BYTE(0) BYTE(6|8|0|128) SHORT(intr_handler_90>>16)  LONG(intr_handler_90>>32)  LONG(0)
    SHORT(intr_handler_91)  SHORT(8) BYTE(0) BYTE(6|8|0|128) SHORT(intr_handler_91>>16)  LONG(intr_handler_91>>32)  LONG(0)
    SHORT(intr_handler_92)  SHORT(8) BYTE(0) BYTE(6|8|0|128) SHORT(intr_handler_92>>16)  LONG(intr_handler_92>>32)  LONG(0)
    SHORT(intr_handler_93)  SHORT(8) BYTE(0) BYTE(6|8|0|128) SHORT(intr_handler_93>>16)  LONG(intr_handler_93>>32)  LONG(0)
    SHORT(intr_handler_94)  SHORT(8) BYTE(0) BYTE(6|8|0|128) SHORT(intr_handler_94>>16)  LONG(intr_handler_94>>32)  LONG(0)
    SHORT(intr_handler_95)  SHORT(8) BYTE(0) BYTE(6|8|0|128) SHORT(intr_handler_95>>16)  LONG(intr_handler_95>>32)  LONG(0)
    SHORT(intr_handler_96)  SHORT(8) BYTE(0) BYTE(6|8|0|128) SHORT(intr_handler_96>>16)  LONG(intr_handler_96>>32)  LONG(0)
    SHORT(intr_handler_97)  SHORT(8) BYTE(0) BYTE(6|8|0|128) SHORT(intr_handler_97>>16)  LONG(intr_handler_97>>32)  LONG(0)
    SHORT(intr_handler_98)  SHORT(8) BYTE(0) BYTE(6|8|0|128) SHORT(intr_handler_98>>16)  LONG(intr_handler_98>>32)  LONG(0)
    SHORT(intr_handler_99)  SHORT(8) BYTE(0) BYTE(6|8|0|128) SHORT(intr_handler_99>>16)  LONG(intr_handler_99>>32)  LONG(0)
    SHORT(intr_handler_100) SHORT(8) BYTE(0) BYTE(6|8|0|128) SHORT(intr_handler_100>>16) LONG(intr_handler_100>>32) LONG(0)
    SHORT(intr_handler_101) SHORT(8) BYTE(0) BYTE(6|8|0|128) SHORT(intr_handler_101>>16) LONG(intr_handler_101>>32) LONG(0)
    SHORT(intr_handler_102) SHORT(8) BYTE(0) BYTE(6|8|0|128) SHORT(intr_handler_102>>16) LONG(intr_handler_102>>32) LONG(0)
    SHORT(intr_handler_103) SHORT(8) BYTE(0) BYTE(6|8|0|128) SHORT(intr_handler_103>>16) LONG(intr_handler_103>>32) LONG(0)
    SHORT(intr_handler_104) SHORT(8) BYTE(0) BYTE(6|8|0|128) SHORT(intr_handler_104>>16) LONG(intr_handler_104>>32) LONG(0)
    SHORT(intr_handler_105) SHORT(8) BYTE(0) BYTE(6|8|0|128) SHORT(intr_handler_105>>16) LONG(intr_handler_105>>32) LONG(0)
    SHORT(intr_handler_106) SHORT(8) BYTE(0) BYTE(6|8|0|128) SHORT(intr_handler_106>>16) LONG(intr_handler_106>>32) LONG(0)
    SHORT(intr_handler_107) SHORT(8) BYTE(0) BYTE(6|8|0|128) SHORT(intr_handler_107>>16) LONG(intr_handler_107>>32) LONG(0)
    SHORT(intr_handler_108) SHORT(8) BYTE(0) BYTE(6|8|0|128) SHORT(intr_handler_108>>16) LONG(intr_handler_108>>32) LONG(0)
    SHORT(intr_handler_109) SHORT(8) BYTE(0) BYTE(6|8|0|128) SHORT(intr_handler_109>>16) LONG(intr_handler_109>>32) LONG(0)
    SHORT(intr_handler_110) SHORT(8) BYTE(0) BYTE(6|8|0|128) SHORT(intr_handler_110>>16) LONG(intr_handler_110>>32) LONG(0)
    SHORT(intr_handler_111) SHORT(8) BYTE(0) BYTE(6|8|0|128) SHORT(intr_handler_111>>16) LONG(intr_handler_111>>32) LONG(0)
    SHORT(intr_handler_112) SHORT(8) BYTE(0) BYTE(6|8|0|128) SHORT(intr_handler_112>>16) LONG(intr_handler_112>>32) LONG(0)
    SHORT(intr_handler_113) SHORT(8) BYTE(0) BYTE(6|8|0|128) SHORT(intr_handler_113>>16) LONG(intr_handler_113>>32) LONG(0)
    SHORT(intr_handler_114) SHORT(8) BYTE(0) BYTE(6|8|0|128) SHORT(intr_handler_114>>16) LONG(intr_handler_114>>32) LONG(0)
    SHORT(intr_handler_115) SHORT(8) BYTE(0) BYTE(6|8|0|128) SHORT(intr_handler_115>>16) LONG(intr_handler_115>>32) LONG(0)
    SHORT(intr_handler_116) SHORT(8) BYTE(0) BYTE(6|8|0|128) SHORT(intr_handler_116>>16) LONG(intr_handler_116>>32) LONG(0)
    SHORT(intr_handler_117) SHORT(8) BYTE(0) BYTE(6|8|0|128) SHORT(intr_handler_117>>16) LONG(intr_handler_117>>32) LONG(0)
    SHORT(intr_handler_118) SHORT(8) BYTE(0) BYTE(6|8|0|128) SHORT(intr_handler_118>>16) LONG(intr_handler_118>>32) LONG(0)
    SHORT(intr_handler_119) SHORT(8) BYTE(0) BYTE(6|8|0|128) SHORT(intr_handler_119>>16) LONG(intr_handler_119>>32) LONG(0)
    SHORT(intr_handler_120) SHORT(8) BYTE(0) BYTE(6|8|0|128) SHORT(intr_handler_120>>16) LONG(intr_handler_120>>32) LONG(0)
    SHORT(intr_handler_121) SHORT(8) BYTE(0) BYTE(6|8|0|128) SHORT(intr_handler_121>>16) LONG(intr_handler_121>>32) LONG(0)
    SHORT(intr_handler_122) SHORT(8) BYTE(0) BYTE(6|8|0|128) SHORT(intr_handler_122>>16) LONG(intr_handler_122>>32) LONG(0)
    SHORT(intr_handler_123) SHORT(8) BYTE(0) BYTE(6|8|0|128) SHORT(intr_handler_123>>16) LONG(intr_handler_123>>32) LONG(0)
    SHORT(intr_handler_124) SHORT(8) BYTE(0) BYTE(6|8|0|128) SHORT(intr_handler_124>>16) LONG(intr_handler_124>>32) LONG(0)
    SHORT(intr_handler_125) SHORT(8) BYTE(0) BYTE(6|8|0|128) SHORT(intr_handler_125>>16) LONG(intr_handler_125>>32) LONG(0)
    SHORT(intr_handler_126) SHORT(8) BYTE(0) BYTE(6|8|0|128) SHORT(intr_handler_126>>16) LONG(intr_handler_126>>32) LONG(0)
    SHORT(intr_handler_127) SHORT(8) BYTE(0) BYTE(6|8|0|128) SHORT(intr_handler_127>>16) LONG(intr_handler_127>>32) LONG(0)
    SHORT(intr_handler_128) SHORT(8) BYTE(0) BYTE(6|8|0|128) SHORT(intr_handler_128>>16) LONG(intr_handler_128>>32) LONG(0)
    SHORT(intr_handler_129) SHORT(8) BYTE(0) BYTE(6|8|0|128) SHORT(intr_handler_129>>16) LONG(intr_handler_129>>32) LONG(0)
    SHORT(intr_handler_130) SHORT(8) BYTE(0) BYTE(6|8|0|128) SHORT(intr_handler_130>>16) LONG(intr_handler_130>>32) LONG(0)
    SHORT(intr_handler_131) SHORT(8) BYTE(0) BYTE(6|8|0|128) SHORT(intr_handler_131>>16) LONG(intr_handler_131>>32) LONG(0)
    SHORT(intr_handler_132) SHORT(8) BYTE(0) BYTE(6|8|0|128) SHORT(intr_handler_132>>16) LONG(intr_handler_132>>32) LONG(0)
    SHORT(intr_handler_133) SHORT(8) BYTE(0) BYTE(6|8|0|128) SHORT(intr_handler_133>>16) LONG(intr_handler_133>>32) LONG(0)
    SHORT(intr_handler_134) SHORT(8) BYTE(0) BYTE(6|8|0|128) SHORT(intr_handler_134>>16) LONG(intr_handler_134>>32) LONG(0)
    SHORT(intr_handler_135) SHORT(8) BYTE(0) BYTE(6|8|0|128) SHORT(intr_handler_135>>16) LONG(intr_handler_135>>32) LONG(0)
    SHORT(intr_handler_136) SHORT(8) BYTE(0) BYTE(6|8|0|128) SHORT(intr_handler_136>>16) LONG(intr_handler_136>>32) LONG(0)
    SHORT(intr_handler_137) SHORT(8) BYTE(0) BYTE(6|8|0|128) SHORT(intr_handler_137>>16) LONG(intr_handler_137>>32) LONG(0)
    SHORT(intr_handler_138) SHORT(8) BYTE(0) BYTE(6|8|0|128) SHORT(intr_handler_138>>16) LONG(intr_handler_138>>32) LONG(0)
    SHORT(intr_handler_139) SHORT(8) BYTE(0) BYTE(6|8|0|128) SHORT(intr_handler_139>>16) LONG(intr_handler_139>>32) LONG(0)
    SHORT(intr_handler_140) SHORT(8) BYTE(0) BYTE(6|8|0|128) SHORT(intr_handler_140>>16) LONG(intr_handler_140>>32) LONG(0)
    SHORT(intr_handler_141) SHORT(8) BYTE(0) BYTE(6|8|0|128) SHORT(intr_handler_141>>16) LONG(intr_handler_141>>32) LONG(0)
    SHORT(intr_handler_142) SHORT(8) BYTE(0) BYTE(6|8|0|128) SHORT(intr_handler_142>>16) LONG(intr_handler_142>>32) LONG(0)
    SHORT(intr_handler_143) SHORT(8) BYTE(0) BYTE(6|8|0|128) SHORT(intr_handler_143>>16) LONG(intr_handler_143>>32) LONG(0)
    SHORT(intr_handler_144) SHORT(8) BYTE(0) BYTE(6|8|0|128) SHORT(intr_handler_144>>16) LONG(intr_handler_144>>32) LONG(0)
    SHORT(intr_handler_145) SHORT(8) BYTE(0) BYTE(6|8|0|128) SHORT(intr_handler_145>>16) LONG(intr_handler_145>>32) LONG(0)
    SHORT(intr_handler_146) SHORT(8) BYTE(0) BYTE(6|8|0|128) SHORT(intr_handler_146>>16) LONG(intr_handler_146>>32) LONG(0)
    SHORT(intr_handler_147) SHORT(8) BYTE(0) BYTE(6|8|0|128) SHORT(intr_handler_147>>16) LONG(intr_handler_147>>32) LONG(0)
    SHORT(intr_handler_148) SHORT(8) BYTE(0) BYTE(6|8|0|128) SHORT(intr_handler_148>>16) LONG(intr_handler_148>>32) LONG(0)
    SHORT(intr_handler_149) SHORT(8) BYTE(0) BYTE(6|8|0|128) SHORT(intr_handler_149>>16) LONG(intr_handler_149>>32) LONG(0)
    SHORT(intr_handler_150) SHORT(8) BYTE(0) BYTE(6|8|0|128) SHORT(intr_handler_150>>16) LONG(intr_handler_150>>32) LONG(0)
    SHORT(intr_handler_151) SHORT(8) BYTE(0) BYTE(6|8|0|128) SHORT(intr_handler_151>>16) LONG(intr_handler_151>>32) LONG(0)
    SHORT(intr_handler_152) SHORT(8) BYTE(0) BYTE(6|8|0|128) SHORT(intr_handler_152>>16) LONG(intr_handler_152>>32) LONG(0)
    SHORT(intr_handler_153) SHORT(8) BYTE(0) BYTE(6|8|0|128) SHORT(intr_handler_153>>16) LONG(intr_handler_153>>32) LONG(0)
    SHORT(intr_handler_154) SHORT(8) BYTE(0) BYTE(6|8|0|128) SHORT(intr_handler_154>>16) LONG(intr_handler_154>>32) LONG(0)
    SHORT(intr_handler_155) SHORT(8) BYTE(0) BYTE(6|8|0|128) SHORT(intr_handler_155>>16) LONG(intr_handler_155>>32) LONG(0)
    SHORT(intr_handler_156) SHORT(8) BYTE(0) BYTE(6|8|0|128) SHORT(intr_handler_156>>16) LONG(intr_handler_156>>32) LONG(0)
    SHORT(intr_handler_157) SHORT(8) BYTE(0) BYTE(6|8|0|128) SHORT(intr_handler_157>>16) LONG(intr_handler_157>>32) LONG(0)
    SHORT(intr_handler_158) SHORT(8) BYTE(0) BYTE(6|8|0|128) SHORT(intr_handler_158>>16) LONG(intr_handler_158>>32) LONG(0)
    SHORT(intr_handler_159) SHORT(8) BYTE(0) BYTE(6|8|0|128) SHORT(intr_handler_159>>16) LONG(intr_handler_159>>32) LONG(0)
    SHORT(intr_handler_160) SHORT(8) BYTE(0) BYTE(6|8|0|128) SHORT(intr_handler_160>>16) LONG(intr_handler_160>>32) LONG(0)
    SHORT(intr_handler_161) SHORT(8) BYTE(0) BYTE(6|8|0|128) SHORT(intr_handler_161>>16) LONG(intr_handler_161>>32) LONG(0)
    SHORT(intr_handler_162) SHORT(8) BYTE(0) BYTE(6|8|0|128) SHORT(intr_handler_162>>16) LONG(intr_handler_162>>32) LONG(0)
    SHORT(intr_handler_163) SHORT(8) BYTE(0) BYTE(6|8|0|128) SHORT(intr_handler_163>>16) LONG(intr_handler_163>>32) LONG(0)
    SHORT(intr_handler_164) SHORT(8) BYTE(0) BYTE(6|8|0|128) SHORT(intr_handler_164>>16) LONG(intr_handler_164>>32) LONG(0)
    SHORT(intr_handler_165) SHORT(8) BYTE(0) BYTE(6|8|0|128) SHORT(intr_handler_165>>16) LONG(intr_handler_165>>32) LONG(0)
    SHORT(intr_handler_166) SHORT(8) BYTE(0) BYTE(6|8|0|128) SHORT(intr_handler_166>>16) LONG(intr_handler_166>>32) LONG(0)
    SHORT(intr_handler_167) SHORT(8) BYTE(0) BYTE(6|8|0|128) SHORT(intr_handler_167>>16) LONG(intr_handler_167>>32) LONG(0)
    SHORT(intr_handler_168) SHORT(8) BYTE(0) BYTE(6|8|0|128) SHORT(intr_handler_168>>16) LONG(intr_handler_168>>32) LONG(0)
    SHORT(intr_handler_169) SHORT(8) BYTE(0) BYTE(6|8|0|128) SHORT(intr_handler_169>>16) LONG(intr_handler_169>>32) LONG(0)
    SHORT(intr_handler_170) SHORT(8) BYTE(0) BYTE(6|8|0|128) SHORT(intr_handler_170>>16) LONG(intr_handler_170>>32) LONG(0)
    SHORT(intr_handler_171) SHORT(8) BYTE(0) BYTE(6|8|0|128) SHORT(intr_handler_171>>16) LONG(intr_handler_171>>32) LONG(0)
    SHORT(intr_handler_172) SHORT(8) BYTE(0) BYTE(6|8|0|128) SHORT(intr_handler_172>>16) LONG(intr_handler_172>>32) LONG(0)
    SHORT(intr_handler_173) SHORT(8) BYTE(0) BYTE(6|8|0|128) SHORT(intr_handler_173>>16) LONG(intr_handler_173>>32) LONG(0)
    SHORT(intr_handler_174) SHORT(8) BYTE(0) BYTE(6|8|0|128) SHORT(intr_handler_174>>16) LONG(intr_handler_174>>32) LONG(0)
    SHORT(intr_handler_175) SHORT(8) BYTE(0) BYTE(6|8|0|128) SHORT(intr_handler_175>>16) LONG(intr_handler_175>>32) LONG(0)
    SHORT(intr_handler_176) SHORT(8) BYTE(0) BYTE(6|8|0|128) SHORT(intr_handler_176>>16) LONG(intr_handler_176>>32) LONG(0)
    SHORT(intr_handler_177) SHORT(8) BYTE(0) BYTE(6|8|0|128) SHORT(intr_handler_177>>16) LONG(intr_handler_177>>32) LONG(0)
    SHORT(intr_handler_178) SHORT(8) BYTE(0) BYTE(6|8|0|128) SHORT(intr_handler_178>>16) LONG(intr_handler_178>>32) LONG(0)
    SHORT(intr_handler_179) SHORT(8) BYTE(0) BYTE(6|8|0|128) SHORT(intr_handler_179>>16) LONG(intr_handler_179>>32) LONG(0)
    SHORT(intr_handler_180) SHORT(8) BYTE(0) BYTE(6|8|0|128) SHORT(intr_handler_180>>16) LONG(intr_handler_180>>32) LONG(0)
    SHORT(intr_handler_181) SHORT(8) BYTE(0) BYTE(6|8|0|128) SHORT(intr_handler_181>>16) LONG(intr_handler_181>>32) LONG(0)
    SHORT(intr_handler_182) SHORT(8) BYTE(0) BYTE(6|8|0|128) SHORT(intr_handler_182>>16) LONG(intr_handler_182>>32) LONG(0)
    SHORT(intr_handler_183) SHORT(8) BYTE(0) BYTE(6|8|0|128) SHORT(intr_handler_183>>16) LONG(intr_handler_183>>32) LONG(0)
    SHORT(intr_handler_184) SHORT(8) BYTE(0) BYTE(6|8|0|128) SHORT(intr_handler_184>>16) LONG(intr_handler_184>>32) LONG(0)
    SHORT(intr_handler_185) SHORT(8) BYTE(0) BYTE(6|8|0|128) SHORT(intr_handler_185>>16) LONG(intr_handler_185>>32) LONG(0)
    SHORT(intr_handler_186) SHORT(8) BYTE(0) BYTE(6|8|0|128) SHORT(intr_handler_186>>16) LONG(intr_handler_186>>32) LONG(0)
    SHORT(intr_handler_187) SHORT(8) BYTE(0) BYTE(6|8|0|128) SHORT(intr_handler_187>>16) LONG(intr_handler_187>>32) LONG(0)
    SHORT(intr_handler_188) SHORT(8) BYTE(0) BYTE(6|8|0|128) SHORT(intr_handler_188>>16) LONG(intr_handler_188>>32) LONG(0)
    SHORT(intr_handler_189) SHORT(8) BYTE(0) BYTE(6|8|0|128) SHORT(intr_handler_189>>16) LONG(intr_handler_189>>32) LONG(0)
    SHORT(intr_handler_190) SHORT(8) BYTE(0) BYTE(6|8|0|128) SHORT(intr_handler_190>>16) LONG(intr_handler_190>>32) LONG(0)
    SHORT(intr_handler_191) SHORT(8) BYTE(0) BYTE(6|8|0|128) SHORT(intr_handler_191>>16) LONG(intr_handler_191>>32) LONG(0)
    SHORT(intr_handler_192) SHORT(8) BYTE(0) BYTE(6|8|0|128) SHORT(intr_handler_192>>16) LONG(intr_handler_192>>32) LONG(0)
    SHORT(intr_handler_193) SHORT(8) BYTE(0) BYTE(6|8|0|128) SHORT(intr_handler_193>>16) LONG(intr_handler_193>>32) LONG(0)
    SHORT(intr_handler_194) SHORT(8) BYTE(0) BYTE(6|8|0|128) SHORT(intr_handler_194>>16) LONG(intr_handler_194>>32) LONG(0)
    SHORT(intr_handler_195) SHORT(8) BYTE(0) BYTE(6|8|0|128) SHORT(intr_handler_195>>16) LONG(intr_handler_195>>32) LONG(0)
    SHORT(intr_handler_196) SHORT(8) BYTE(0) BYTE(6|8|0|128) SHORT(intr_handler_196>>16) LONG(intr_handler_196>>32) LONG(0)
    SHORT(intr_handler_197) SHORT(8) BYTE(0) BYTE(6|8|0|128) SHORT(intr_handler_197>>16) LONG(intr_handler_197>>32) LONG(0)
    SHORT(intr_handler_198) SHORT(8) BYTE(0) BYTE(6|8|0|128) SHORT(intr_handler_198>>16) LONG(intr_handler_198>>32) LONG(0)
    SHORT(intr_handler_199) SHORT(8) BYTE(0) BYTE(6|8|0|128) SHORT(intr_handler_199>>16) LONG(intr_handler_199>>32) LONG(0)
    SHORT(intr_handler_200) SHORT(8) BYTE(0) BYTE(6|8|0|128) SHORT(intr_handler_200>>16) LONG(intr_handler_200>>32) LONG(0)
    SHORT(intr_handler_201) SHORT(8) BYTE(0) BYTE(6|8|0|128) SHORT(intr_handler_201>>16) LONG(intr_handler_201>>32) LONG(0)
    SHORT(intr_handler_202) SHORT(8) BYTE(0) BYTE(6|8|0|128) SHORT(intr_handler_202>>16) LONG(intr_handler_202>>32) LONG(0)
    SHORT(intr_handler_203) SHORT(8) BYTE(0) BYTE(6|8|0|128) SHORT(intr_handler_203>>16) LONG(intr_handler_203>>32) LONG(0)
    SHORT(intr_handler_204) SHORT(8) BYTE(0) BYTE(6|8|0|128) SHORT(intr_handler_204>>16) LONG(intr_handler_204>>32) LONG(0)
    SHORT(intr_handler_205) SHORT(8) BYTE(0) BYTE(6|8|0|128) SHORT(intr_handler_205>>16) LONG(intr_handler_205>>32) LONG(0)
    SHORT(intr_handler_206) SHORT(8) BYTE(0) BYTE(6|8|0|128) SHORT(intr_handler_206>>16) LONG(intr_handler_206>>32) LONG(0)
    SHORT(intr_handler_207) SHORT(8) BYTE(0) BYTE(6|8|0|128) SHORT(intr_handler_207>>16) LONG(intr_handler_207>>32) LONG(0)
    SHORT(intr_handler_208) SHORT(8) BYTE(0) BYTE(6|8|0|128) SHORT(intr_handler_208>>16) LONG(intr_handler_208>>32) LONG(0)
    SHORT(intr_handler_209) SHORT(8) BYTE(0) BYTE(6|8|0|128) SHORT(intr_handler_209>>16) LONG(intr_handler_209>>32) LONG(0)
    SHORT(intr_handler_210) SHORT(8) BYTE(0) BYTE(6|8|0|128) SHORT(intr_handler_210>>16) LONG(intr_handler_210>>32) LONG(0)
    SHORT(intr_handler_211) SHORT(8) BYTE(0) BYTE(6|8|0|128) SHORT(intr_handler_211>>16) LONG(intr_handler_211>>32) LONG(0)
    SHORT(intr_handler_212) SHORT(8) BYTE(0) BYTE(6|8|0|128) SHORT(intr_handler_212>>16) LONG(intr_handler_212>>32) LONG(0)
    SHORT(intr_handler_213) SHORT(8) BYTE(0) BYTE(6|8|0|128) SHORT(intr_handler_213>>16) LONG(intr_handler_213>>32) LONG(0)
    SHORT(intr_handler_214) SHORT(8) BYTE(0) BYTE(6|8|0|128) SHORT(intr_handler_214>>16) LONG(intr_handler_214>>32) LONG(0)
    SHORT(intr_handler_215) SHORT(8) BYTE(0) BYTE(6|8|0|128) SHORT(intr_handler_215>>16) LONG(intr_handler_215>>32) LONG(0)
    SHORT(intr_handler_216) SHORT(8) BYTE(0) BYTE(6|8|0|128) SHORT(intr_handler_216>>16) LONG(intr_handler_216>>32) LONG(0)
    SHORT(intr_handler_217) SHORT(8) BYTE(0) BYTE(6|8|0|128) SHORT(intr_handler_217>>16) LONG(intr_handler_217>>32) LONG(0)
    SHORT(intr_handler_218) SHORT(8) BYTE(0) BYTE(6|8|0|128) SHORT(intr_handler_218>>16) LONG(intr_handler_218>>32) LONG(0)
    SHORT(intr_handler_219) SHORT(8) BYTE(0) BYTE(6|8|0|128) SHORT(intr_handler_219>>16) LONG(intr_handler_219>>32) LONG(0)
    SHORT(intr_handler_220) SHORT(8) BYTE(0) BYTE(6|8|0|128) SHORT(intr_handler_220>>16) LONG(intr_handler_220>>32) LONG(0)
    SHORT(intr_handler_221) SHORT(8) BYTE(0) BYTE(6|8|0|128) SHORT(intr_handler_221>>16) LONG(intr_handler_221>>32) LONG(0)
    SHORT(intr_handler_222) SHORT(8) BYTE(0) BYTE(6|8|0|128) SHORT(intr_handler_222>>16) LONG(intr_handler_222>>32) LONG(0)
    SHORT(intr_handler_223) SHORT(8) BYTE(0) BYTE(6|8|0|128) SHORT(intr_handler_223>>16) LONG(intr_handler_223>>32) LONG(0)
    SHORT(intr_handler_224) SHORT(8) BYTE(0) BYTE(6|8|0|128) SHORT(intr_handler_224>>16) LONG(intr_handler_224>>32) LONG(0)
    SHORT(intr_handler_225) SHORT(8) BYTE(0) BYTE(6|8|0|128) SHORT(intr_handler_225>>16) LONG(intr_handler_225>>32) LONG(0)
    SHORT(intr_handler_226) SHORT(8) BYTE(0) BYTE(6|8|0|128) SHORT(intr_handler_226>>16) LONG(intr_handler_226>>32) LONG(0)
    SHORT(intr_handler_227) SHORT(8) BYTE(0) BYTE(6|8|0|128) SHORT(intr_handler_227>>16) LONG(intr_handler_227>>32) LONG(0)
    SHORT(intr_handler_228) SHORT(8) BYTE(0) BYTE(6|8|0|128) SHORT(intr_handler_228>>16) LONG(intr_handler_228>>32) LONG(0)
    SHORT(intr_handler_229) SHORT(8) BYTE(0) BYTE(6|8|0|128) SHORT(intr_handler_229>>16) LONG(intr_handler_229>>32) LONG(0)
    SHORT(intr_handler_230) SHORT(8) BYTE(0) BYTE(6|8|0|128) SHORT(intr_handler_230>>16) LONG(intr_handler_230>>32) LONG(0)
    SHORT(intr_handler_231) SHORT(8) BYTE(0) BYTE(6|8|0|128) SHORT(intr_handler_231>>16) LONG(intr_handler_231>>32) LONG(0)
    SHORT(intr_handler_232) SHORT(8) BYTE(0) BYTE(6|8|0|128) SHORT(intr_handler_232>>16) LONG(intr_handler_232>>32) LONG(0)
    SHORT(intr_handler_233) SHORT(8) BYTE(0) BYTE(6|8|0|128) SHORT(intr_handler_233>>16) LONG(intr_handler_233>>32) LONG(0)
    SHORT(intr_handler_234) SHORT(8) BYTE(0) BYTE(6|8|0|128) SHORT(intr_handler_234>>16) LONG(intr_handler_234>>32) LONG(0)
    SHORT(intr_handler_235) SHORT(8) BYTE(0) BYTE(6|8|0|128) SHORT(intr_handler_235>>16) LONG(intr_handler_235>>32) LONG(0)
    SHORT(intr_handler_236) SHORT(8) BYTE(0) BYTE(6|8|0|128) SHORT(intr_handler_236>>16) LONG(intr_handler_236>>32) LONG(0)
    SHORT(intr_handler_237) SHORT(8) BYTE(0) BYTE(6|8|0|128) SHORT(intr_handler_237>>16) LONG(intr_handler_237>>32) LONG(0)
    SHORT(intr_handler_238) SHORT(8) BYTE(0) BYTE(6|8|0|128) SHORT(intr_handler_238>>16) LONG(intr_handler_238>>32) LONG(0)
    SHORT(intr_handler_239) SHORT(8) BYTE(0) BYTE(6|8|0|128) SHORT(intr_handler_239>>16) LONG(intr_handler_239>>32) LONG(0)
    SHORT(intr_handler_240) SHORT(8) BYTE(0) BYTE(6|8|0|128) SHORT(intr_handler_240>>16) LONG(intr_handler_240>>32) LONG(0)
    SHORT(intr_handler_241) SHORT(8) BYTE(0) BYTE(6|8|0|128) SHORT(intr_handler_241>>16) LONG(intr_handler_241>>32) LONG(0)
    SHORT(intr_handler_242) SHORT(8) BYTE(0) BYTE(6|8|0|128) SHORT(intr_handler_242>>16) LONG(intr_handler_242>>32) LONG(0)
    SHORT(intr_handler_243) SHORT(8) BYTE(0) BYTE(6|8|0|128) SHORT(intr_handler_243>>16) LONG(intr_handler_243>>32) LONG(0)
    SHORT(intr_handler_244) SHORT(8) BYTE(0) BYTE(6|8|0|128) SHORT(intr_handler_244>>16) LONG(intr_handler_244>>32) LONG(0)
    SHORT(intr_handler_245) SHORT(8) BYTE(0) BYTE(6|8|0|128) SHORT(intr_handler_245>>16) LONG(intr_handler_245>>32) LONG(0)
    SHORT(intr_handler_246) SHORT(8) BYTE(0) BYTE(6|8|0|128) SHORT(intr_handler_246>>16) LONG(intr_handler_246>>32) LONG(0)
    SHORT(intr_handler_247) SHORT(8) BYTE(0) BYTE(6|8|0|128) SHORT(intr_handler_247>>16) LONG(intr_handler_247>>32) LONG(0)
    SHORT(intr_handler_248) SHORT(8) BYTE(0) BYTE(6|8|0|128) SHORT(intr_handler_248>>16) LONG(intr_handler_248>>32) LONG(0)
    SHORT(intr_handler_249) SHORT(8) BYTE(0) BYTE(6|8|0|128) SHORT(intr_handler_249>>16) LONG(intr_handler_249>>32) LONG(0)
    SHORT(intr_handler_250) SHORT(8) BYTE(0) BYTE(6|8|0|128) SHORT(intr_handler_250>>16) LONG(intr_handler_250>>32) LONG(0)
    SHORT(intr_handler_251) SHORT(8) BYTE(0) BYTE(6|8|0|128) SHORT(intr_handler_251>>16) LONG(intr_handler_251>>32) LONG(0)
    SHORT(intr_handler_252) SHORT(8) BYTE(0) BYTE(6|8|0|128) SHORT(intr_handler_252>>16) LONG(intr_handler_252>>32) LONG(0)
    SHORT(intr_handler_253) SHORT(8) BYTE(0) BYTE(6|8|0|128) SHORT(intr_handler_253>>16) LONG(intr_handler_253>>32) LONG(0)
    SHORT(intr_handler_254) SHORT(8) BYTE(0) BYTE(6|8|0|128) SHORT(intr_handler_254>>16) LONG(intr_handler_254>>32) LONG(0)
    SHORT(intr_handler_255) SHORT(8) BYTE(0) BYTE(6|8|0|128) SHORT(intr_handler_255>>16) LONG(intr_handler_255>>32) LONG(0)

    . = ALIGN(0x1000);
    _section_rodata_end = .;
  }

  .data :
  {
    . = ALIGN(0x1000);
    _section_data_start = .;
    *(.data)
    *(.data.*)
    . = ALIGN(0x1000);
    _section_data_end = .;
  }

  .bss :
  {
    . = ALIGN(0x1000);
    _section_bss_start = .;
    *(.bss)
    *(.bss.*)
    . = ALIGN(0x1000);
    _section_bss_end = .;
  }

  _kernel_memory_end = .;
}
